## CMakeLists.txt
```
# SPDX-License-Identifier: Apache-2.0

cmake_minimum_required(VERSION 3.20.0)

find_package(Zephyr)
project(app1)

target_include_directories(app PRIVATE ${ZEPHYR_BASE}/subsys/net/ip)

target_sources(app PRIVATE
	src/main.c
	src/static.c
)
```

## sample.yaml
```
sample:
  description: First application using re
  name: re_example
common:
  harness: net
  tags:
    - net
    - socket
  filter: TOOLCHAIN_HAS_NEWLIB == 1
  depends_on: re
```

## prj.conf
```kconfig
# General config
CONFIG_NEWLIB_LIBC=y
CONFIG_MAIN_STACK_SIZE=2048
CONFIG_POSIX_API=y

# Networking config
CONFIG_NETWORKING=y
CONFIG_NET_IPV4=y
CONFIG_NET_IPV6=y
CONFIG_NET_TCP=y
CONFIG_NET_SOCKETS=y
CONFIG_NET_SOCKETS_POSIX_NAMES=n
CONFIG_NET_SOCKETS_POLL_MAX=20
CONFIG_NET_CONFIG_AUTO_INIT=y

# Network driver config
CONFIG_TEST_RANDOM_GENERATOR=y

# Network address config
CONFIG_NET_CONFIG_SETTINGS=y
CONFIG_NET_CONFIG_NEED_IPV4=y
CONFIG_NET_CONFIG_NEED_IPV6=y
CONFIG_NET_CONFIG_MY_IPV4_ADDR="192.168.110.57"
CONFIG_NET_CONFIG_MY_IPV6_ADDR="2001:db8::1"

CONFIG_MBEDTLS=y
CONFIG_MBEDTLS_DEBUG=y
CONFIG_MBEDTLS_ENTROPY_ENABLED=y
CONFIG_MBEDTLS_CTR_DRBG_ENABLED=y
CONFIG_MBEDTLS_PSA_CRYPTO_C=y
CONFIG_I2S=y
CONFIG_I2C=y
CONFIG_DMA_TCD_QUEUE_SIZE=8
CONFIG_DYNAMIC_THREAD=y
CONFIG_DYNAMIC_THREAD_PREFER_POOL=y
CONFIG_DYNAMIC_THREAD_STACK_SIZE=65536
CONFIG_DYNAMIC_THREAD_POOL_SIZE=4
CONFIG_NET_MGMT_EVENT=y
CONFIG_DNS_SERVER_IP_ADDRESSES=y
CONFIG_DNS_SERVER1="10.1.0.1"
CONFIG_DNS_SERVER2="1.1.1.1"
CONFIG_SNTP=y
CONFIG_DNS_RESOLVER=y

CONFIG_MAX_PTHREAD_COUNT=4
CONFIG_MAX_PTHREAD_MUTEX_COUNT=20
CONFIG_HEAP_MEM_POOL_SIZE=16384
```

## src/main.c
```c
/*
 * Copyright (c) 2019 Linaro Limited
 *
 * SPDX-License-Identifier: Apache-2.0
 */

#include <stdio.h>
#include <stdlib.h>
#include <stdbool.h>
#include <errno.h>
#include <sys/time.h>
#include <time.h>
#include <unistd.h>
#include <zephyr/net/net_config.h>

#include <re.h>
#include <baresip.h>


int extern_baresip_config(struct conf *conf)
{
	conf_set(conf, "sip_listen", "0.0.0.0:5060");
	conf_set(conf, "rtp_stats", "no");
	conf_set(conf, "rtcp_enable", "no");
	conf_set(conf, "module", "opus");
	conf_set(conf, "module", "g711");
	conf_set(conf, "module", "auwm8960\n");
	conf_set(conf, "module", "auresamp\n");
	conf_set(conf, "module_app", "menu\n");

	conf_set(conf, "audio_player", "auwm8960\n");
	conf_set(conf, "audio_source", "auwm8960\n");
	conf_set(conf, "audio_alert", "auwm8960\n");
/*        conf_set(conf, "audio_channels", "2\n");*/
/*        conf_set(conf, "audio_srate", "48000\n");*/

	conf_set(conf, "opus_stereo", "yes\n");
	conf_set(conf, "opus_sprop_stereo", "yes\n");

	return config_parse_conf(conf_config(), conf);
}


static void ua_exit_handler(void *arg)
{
	(void)arg;
	debug("ua exited -- stopping main runloop\n");

	/* The main run-loop can be stopped now */
	re_cancel();
}


static void *baresip_thread(void *arg)
{
	int err;

	err = libre_init();
	if (err) {
		warning("Could not init libre\n");
		return NULL;
	}

	err  = conf_configure();
	err |= extern_baresip_config(conf_cur());
	if (err) {
		warning("Could not configure baresip.\n");
		return NULL;
	}

	err = baresip_init(conf_config());
	if (err) {
		warning("Could not initialize baresip\n");
		goto out;
	}

	err = ua_init(NULL, true, true, false);
	if (err)
		goto out;

	uag_set_exit_handler(ua_exit_handler, NULL);

	/* Load modules */
	err = conf_modules();
	if (err)
		goto out;

	ua_alloc(NULL, "<sip:zephyr@localhost>;answermode=auto");
	printf("Starting main loop now ...\n");
	err = re_main(NULL);
	printf("Main loop left\n");
out:

	ua_stop_all(true);

	ua_close();
	conf_close();

	baresip_close();

	info("main: unloading modules\n");
	mod_close();

	libre_close();

	// Check for memory leaks
	tmr_debug();
	mem_debug();
	return NULL;
}


static void receiver_cb(struct net_mgmt_event_callback *cb,
			uint32_t nm_event, struct net_if *iface)
{
	printf("%s:%d HUUUUUU %u\n", __func__, __LINE__, nm_event);
	if (nm_event == NET_EVENT_IPV4_ADDR_ADD) {
		printf("Got IP:\n");
	}
}


int main(void)
{
	struct net_mgmt_event_callback rx_cb;
	pthread_t tid;

	(void) pthread_create(&tid, NULL, baresip_thread, NULL);
	net_mgmt_init_event_callback(&rx_cb, receiver_cb,
				     NET_EVENT_IPV4_ADDR_ADD);
	net_mgmt_add_event_callback(&rx_cb);

	while (1) {
		sleep(1);
	}
}
```

## src/static.c
```c
#include <re_types.h>
#include <re_mod.h>

extern const struct mod_export exports_auconv;
extern const struct mod_export exports_auresamp;
extern const struct mod_export exports_auwm8960;
extern const struct mod_export exports_g711;
extern const struct mod_export exports_menu;
extern const struct mod_export exports_opus;


const struct mod_export *mod_table[] = {
  &exports_auconv,
  &exports_auresamp,
  &exports_auwm8960,
  &exports_g711,
  &exports_menu,
  &exports_opus,

  NULL
};
```
